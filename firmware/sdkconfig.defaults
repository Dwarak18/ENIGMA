## firmware/sdkconfig.defaults
```kconfig
# ENIGMA Firmware SDK Config Defaults

# NVS encryption disabled (requires eFuse HMAC key – not needed for local dev)
# CONFIG_NVS_ENCRYPTION=y

# Flash encryption (enable for production)
# CONFIG_FLASH_ENCRYPTION_ENABLED=y
# CONFIG_SECURE_BOOT=y

# Enable mbedTLS
CONFIG_MBEDTLS_ECDSA_C=y
CONFIG_MBEDTLS_ECP_C=y
CONFIG_MBEDTLS_ECP_DP_SECP256R1_ENABLED=y
CONFIG_MBEDTLS_SHA256_C=y
CONFIG_MBEDTLS_ENTROPY_C=y
CONFIG_MBEDTLS_CTR_DRBG_C=y

# HTTPS / TLS
CONFIG_ESP_TLS_USING_MBEDTLS=y
CONFIG_MBEDTLS_CERTIFICATE_BUNDLE=y
CONFIG_MBEDTLS_CERTIFICATE_BUNDLE_DEFAULT_FULL=y

# SNTP for timestamp sync
CONFIG_LWIP_SNTP_MAX_SERVERS=3

# Logging
CONFIG_LOG_DEFAULT_LEVEL_INFO=y

# HTTP client (plain HTTP for local dev – no TLS needed)
CONFIG_ESP_HTTP_CLIENT_ENABLE_HTTPS=n

# Task watchdog
CONFIG_ESP_TASK_WDT=y
CONFIG_ESP_TASK_WDT_TIMEOUT_S=30
```
